## CMakeLists.txt
```
# SeeedMote v2 — mote_motion_nrf52840 Zephyr app build.
#
# Standard Zephyr / NCS workspace app layout. Run from this directory:
#   west build -b xiao_ble

cmake_minimum_required(VERSION 3.20.0)

find_package(Zephyr REQUIRED HINTS $ENV{ZEPHYR_BASE})
project(mote_motion_nrf52840)

target_sources(app PRIVATE
    src/main.c
    src/cfg_svc.c
    src/motion_gate.c
)
```

## west.yml
```
# SeeedMote v2 — west manifest for the mote project.
#
# Mote uses west + nRF Connect SDK (NCS), NOT PlatformIO. PIO's Zephyr
# framework is stuck on Zephyr 2.7 (2021), too old for our low-power BLE
# work — see docs/architecture.md for the dual-track rationale.
#
# Bootstrap (one-time):
#   cd projects/mote_motion_nrf52840
#   west init -l .
#   west update          # downloads ~4 GB of NCS + Zephyr sources
#
# Build:
#   west build -b xiao_ble
#
# Flash (UF2 drag-n-drop):
#   cp build/zephyr/zephyr.uf2 /Volumes/XIAOBOOT/

manifest:
  self:
    path: projects/mote_motion_nrf52840

  remotes:
    - name: ncs
      url-base: https://github.com/nrfconnect

  projects:
    - name: sdk-nrf
      remote: ncs
      revision: v2.9.2
      path: nrf
      import: true
```

## prj.conf
```kconfig
# SeeedMote v2 — mote_motion_nrf52840 Zephyr config.
#
# Production / low-power defaults. Wakes the MCU only on IMU data-ready and
# stays in System ON sleep otherwise (CONFIG_PM=y → WFI in idle).
#
# For a build with USB CDC console (hands-free dev without an SWD probe),
# overlay debug.conf:
#   make build DEBUG=1
#
# OTA is explicitly disabled. Settings/NVS uses the board's existing
# storage_partition for Web BT IMU tuning persistence.

# --- Logging (RTT only by default; UART backend lives in debug.conf) -------
CONFIG_LOG=y
CONFIG_LOG_MODE_DEFERRED=y
CONFIG_LOG_BACKEND_RTT=y
CONFIG_USE_SEGGER_RTT=y

# --- Power management ------------------------------------------------------
# nRF52840 in NCS v2.9.2 does NOT select HAS_PM, so CONFIG_PM is silently
# dropped — and we don't need it. Cortex-M's default arch_cpu_idle() already
# emits WFI in the idle thread, which lands the chip in System ON sleep
# (clock stopped, RAM retained, peripheral interrupts wake). The real
# low-power gates are: no USB CDC, no blink thread, sem waits K_FOREVER
# when there's no burst pending. See main.c.
#
# PM_DEVICE is independent and does work — it lets the LSM6DSL driver
# expose suspend/resume hooks (useful for Stage 2).
CONFIG_PM_DEVICE=y

# --- GPIO / I2C / sensor framework -----------------------------------------
CONFIG_GPIO=y
CONFIG_I2C=y
CONFIG_SENSOR=y

# LSM6DS3TR-C uses the LSM6DSL-compatible binding in NCS / Zephyr.
CONFIG_LSM6DSL=y

# --- Bluetooth -------------------------------------------------------------
CONFIG_BT=y
CONFIG_BT_BROADCASTER=y
CONFIG_BT_PERIPHERAL=y
CONFIG_BT_DEVICE_NAME="SEEED-BOOT"
CONFIG_BT_DEVICE_NAME_DYNAMIC=y
CONFIG_BT_DEVICE_APPEARANCE=0

# Web BT config service uses sys_reboot() for the "factory reset" command.
CONFIG_REBOOT=y

# --- Persistent Web BT tuning ---------------------------------------------
CONFIG_FLASH=y
CONFIG_FLASH_MAP=y
CONFIG_NVS=y
CONFIG_SETTINGS=y
CONFIG_SETTINGS_NVS=y

# --- Explicitly off --------------------------------------------------------
# The xiao_ble board defconfig force-enables USB_DEVICE_STACK + a USB CDC
# console, and the board DTS pins zephyr,console = &usb_cdc_acm_uart. To
# get a true release build (no ~3 mA USB quiescent draw) we have to undo
# all of that explicitly here; debug.conf flips the USB knobs back on.
CONFIG_USB_DEVICE_STACK=n
CONFIG_USB_CDC_ACM=n
CONFIG_SERIAL=n
CONFIG_CONSOLE=n
CONFIG_UART_CONSOLE=n
CONFIG_LOG_BACKEND_UART=n

CONFIG_SHELL=n
CONFIG_FILE_SYSTEM=n
```

## debug.conf
```kconfig
# SeeedMote v2 — debug overlay.
#
# Adds USB CDC ACM console so log output is visible over the USB-C cable
# without an SWD/RTT probe. The XIAO nRF52840 Sense does not expose SWD on
# the standard header, so this is the practical default for desk debugging.
#
# Apply with:  make build DEBUG=1
#
# Cost: ~3 mA continuous quiescent current — never ship this in a battery
# build. The default prj.conf already routes logs to RTT.
#
# Note: prj.conf hard-disables CONSOLE / UART_CONSOLE / LOG_BACKEND_UART /
# SERIAL so that the release build truly drops them (the xiao_ble board
# defconfig would otherwise force them on whenever USB_DEVICE_STACK=y).
# Here we re-enable each one explicitly.

CONFIG_USB_DEVICE_STACK=y
CONFIG_USB_CDC_ACM=y
CONFIG_USB_DEVICE_PRODUCT="seeedmote-motion"
CONFIG_USB_DEVICE_VID=0x2886
CONFIG_USB_DEVICE_PID=0x0045

CONFIG_SERIAL=y
CONFIG_UART_INTERRUPT_DRIVEN=y
CONFIG_UART_LINE_CTRL=y
CONFIG_CONSOLE=y
CONFIG_UART_CONSOLE=y

# Defer USB init until main() calls usb_enable(); otherwise USB races BT
# controller setup in SYS_INIT and the chip panics before LED ever blinks.
CONFIG_USB_DEVICE_INITIALIZE_AT_BOOT=n

# Route Zephyr LOG_* through the USB CDC UART exposed by the board overlay.
CONFIG_LOG_BACKEND_UART=y

# Needed for sys_reboot() in the 1200-baud touch DFU trigger (see main.c).
CONFIG_REBOOT=y
```

## src/cfg_svc.c
```c
/*
 * SeeedMote v2 — Web BT config GATT service implementation.
 *
 *   Primary service     a8b00001-3e8e-4b8f-9a1c-9b1f5e88aa00
 *     THS char (r/w u8) a8b00002-3e8e-4b8f-9a1c-9b1f5e88aa00
 *     DUR char (r/w u8) a8b00003-3e8e-4b8f-9a1c-9b1f5e88aa00
 *     CMD char (w u8)   a8b00004-3e8e-4b8f-9a1c-9b1f5e88aa00
 *
 * THS / DUR are LSM6DSL register payloads (see datasheet 0x5B/0x5C);
 * CMD currently accepts 0x01 = cold reboot. Reboot is deferred 200 ms so
 * the GATT write response goes out before NVIC reset.
 *
 * Handlers run in the BT RX thread. THS/DUR writes update the live IMU
 * registers and synchronously persist via Zephyr settings/NVS in main.c.
 */

#include <stdint.h>

#include <zephyr/kernel.h>
#include <zephyr/sys/reboot.h>
#include <zephyr/bluetooth/uuid.h>
#include <zephyr/bluetooth/gatt.h>
#include <zephyr/logging/log.h>

#include "cfg_svc.h"

LOG_MODULE_REGISTER(cfg_svc, LOG_LEVEL_INF);

#define BT_UUID_CFG_SVC_VAL \
    BT_UUID_128_ENCODE(0xa8b00001, 0x3e8e, 0x4b8f, 0x9a1c, 0x9b1f5e88aa00)
#define BT_UUID_CFG_THS_VAL \
    BT_UUID_128_ENCODE(0xa8b00002, 0x3e8e, 0x4b8f, 0x9a1c, 0x9b1f5e88aa00)
#define BT_UUID_CFG_DUR_VAL \
    BT_UUID_128_ENCODE(0xa8b00003, 0x3e8e, 0x4b8f, 0x9a1c, 0x9b1f5e88aa00)
#define BT_UUID_CFG_CMD_VAL \
    BT_UUID_128_ENCODE(0xa8b00004, 0x3e8e, 0x4b8f, 0x9a1c, 0x9b1f5e88aa00)

static struct bt_uuid_128 svc_uuid = BT_UUID_INIT_128(BT_UUID_CFG_SVC_VAL);
static struct bt_uuid_128 ths_uuid = BT_UUID_INIT_128(BT_UUID_CFG_THS_VAL);
static struct bt_uuid_128 dur_uuid = BT_UUID_INIT_128(BT_UUID_CFG_DUR_VAL);
static struct bt_uuid_128 cmd_uuid = BT_UUID_INIT_128(BT_UUID_CFG_CMD_VAL);

#define CMD_REBOOT 0x01u

static void deferred_reboot(struct k_work *work)
{
    ARG_UNUSED(work);
    imu_save_config();
    LOG_INF("cfg cmd: rebooting now");
    sys_reboot(SYS_REBOOT_COLD);
}
static K_WORK_DELAYABLE_DEFINE(reboot_work, deferred_reboot);

static ssize_t read_ths(struct bt_conn *conn, const struct bt_gatt_attr *attr,
                        void *buf, uint16_t len, uint16_t offset)
{
    ARG_UNUSED(attr);
    uint8_t v = imu_get_wake_ths();
    return bt_gatt_attr_read(conn, attr, buf, len, offset, &v, sizeof(v));
}

static ssize_t read_dur(struct bt_conn *conn, const struct bt_gatt_attr *attr,
                        void *buf, uint16_t len, uint16_t offset)
{
    ARG_UNUSED(attr);
    uint8_t v = imu_get_wake_dur();
    return bt_gatt_attr_read(conn, attr, buf, len, offset, &v, sizeof(v));
}

static ssize_t write_ths(struct bt_conn *conn, const struct bt_gatt_attr *attr,
                         const void *buf, uint16_t len, uint16_t offset, uint8_t flags)
{
    ARG_UNUSED(conn); ARG_UNUSED(attr); ARG_UNUSED(flags);
    if (offset != 0 || len != 1) {
        return BT_GATT_ERR(BT_ATT_ERR_INVALID_ATTRIBUTE_LEN);
    }
    uint8_t v = ((const uint8_t *)buf)[0];
    if (imu_set_wake_ths(v)) {
        return BT_GATT_ERR(BT_ATT_ERR_UNLIKELY);
    }
    LOG_INF("THS <- 0x%02x", v);
    return len;
}

static ssize_t write_dur(struct bt_conn *conn, const struct bt_gatt_attr *attr,
                         const void *buf, uint16_t len, uint16_t offset, uint8_t flags)
{
    ARG_UNUSED(conn); ARG_UNUSED(attr); ARG_UNUSED(flags);
    if (offset != 0 || len != 1) {
        return BT_GATT_ERR(BT_ATT_ERR_INVALID_ATTRIBUTE_LEN);
    }
    uint8_t v = ((const uint8_t *)buf)[0];
    if (imu_set_wake_dur(v)) {
        return BT_GATT_ERR(BT_ATT_ERR_UNLIKELY);
    }
    LOG_INF("DUR <- 0x%02x", v);
    return len;
}

static ssize_t write_cmd(struct bt_conn *conn, const struct bt_gatt_attr *attr,
                         const void *buf, uint16_t len, uint16_t offset, uint8_t flags)
{
    ARG_UNUSED(conn); ARG_UNUSED(attr); ARG_UNUSED(flags);
    if (offset != 0 || len != 1) {
        return BT_GATT_ERR(BT_ATT_ERR_INVALID_ATTRIBUTE_LEN);
    }
    uint8_t cmd = ((const uint8_t *)buf)[0];
    if (cmd == CMD_REBOOT) {
        k_work_schedule(&reboot_work, K_MSEC(200));
        return len;
    }
    return BT_GATT_ERR(BT_ATT_ERR_VALUE_NOT_ALLOWED);
}

/* clang-format off */
BT_GATT_SERVICE_DEFINE(cfg_svc,
    BT_GATT_PRIMARY_SERVICE(&svc_uuid),
    BT_GATT_CHARACTERISTIC(&ths_uuid.uuid,
                           BT_GATT_CHRC_READ | BT_GATT_CHRC_WRITE,
                           BT_GATT_PERM_READ | BT_GATT_PERM_WRITE,
                           read_ths, write_ths, NULL),
    BT_GATT_CHARACTERISTIC(&dur_uuid.uuid,
                           BT_GATT_CHRC_READ | BT_GATT_CHRC_WRITE,
                           BT_GATT_PERM_READ | BT_GATT_PERM_WRITE,
                           read_dur, write_dur, NULL),
    BT_GATT_CHARACTERISTIC(&cmd_uuid.uuid,
                           BT_GATT_CHRC_WRITE,
                           BT_GATT_PERM_WRITE,
                           NULL, write_cmd, NULL),
);
/* clang-format on */
```

## src/cfg_svc.h
```c
/*
 * SeeedMote v2 — Web BT config GATT service.
 *
 * Exposes IMU wake-up tuning (THS, DUR) and a reboot command to a Web BT
 * client during the 30 s connectable config window. See `tools/web-bt/`.
 *
 * Backing storage is Zephyr settings/NVS: writes update the live IMU
 * registers and persist across reboot. Missing settings fall back to
 * LSM6DSL_WAKE_UP_THS_DEFAULT / _DUR_DEFAULT in main.c.
 */

#pragma once

#include <stdint.h>

/* main.c provides the runtime accessors backing the GATT characteristics. */
uint8_t imu_get_wake_ths(void);
uint8_t imu_get_wake_dur(void);
int imu_set_wake_ths(uint8_t value);
int imu_set_wake_dur(uint8_t value);

/* Persist current THS/DUR to NVS.  Call from a non-BT context (work queue)
 * so flash writes don't block the radio. */
void imu_save_config(void);
```

## src/motion_gate.c
```c
#include "motion_gate.h"

static int32_t abs_i32(int32_t value)
{
    return value < 0 ? -value : value;
}

int32_t motion_score_mg(const struct motion_sample *samples, size_t count)
{
    int32_t max_delta = 0;

    if (samples == NULL || count < 2) {
        return 0;
    }

    for (size_t i = 1; i < count; i++) {
        int32_t dx = (int32_t)samples[i].x - samples[i - 1].x;
        int32_t dy = (int32_t)samples[i].y - samples[i - 1].y;
        int32_t dz = (int32_t)samples[i].z - samples[i - 1].z;
        int32_t delta = abs_i32(dx) + abs_i32(dy) + abs_i32(dz);

        if (delta > max_delta) {
            max_delta = delta;
        }
    }

    /* LSM6DSL/LSM6DS3TR-C at +/-2g is 0.061 mg per LSB. */
    return (max_delta * 61) / 1000;
}

enum motion_gate_decision motion_gate_update(struct motion_gate *gate,
                                             const struct motion_gate_config *cfg,
                                             bool hw_wake,
                                             bool hw_inactivity,
                                             int32_t score_mg,
                                             int64_t now_ms)
{
    bool score_wake;

    if (gate == NULL || cfg == NULL) {
        return MOTION_GATE_NONE;
    }

    if (hw_inactivity) {
        gate->moving = false;
        if (!hw_wake) {
            return MOTION_GATE_INACTIVITY;
        }
    }

    score_wake = score_mg >= cfg->min_score_mg;
    if (!hw_wake && !score_wake) {
        return MOTION_GATE_NONE;
    }

    gate->moving = true;
    if (gate->has_last_emit &&
        (now_ms - gate->last_emit_ms) < cfg->cooldown_ms) {
        return MOTION_GATE_NONE;
    }

    gate->has_last_emit = true;
    gate->last_emit_ms = now_ms;
    return MOTION_GATE_EMIT;
}
```

## src/motion_gate.h
```c
#pragma once

#include <stdbool.h>
#include <stddef.h>
#include <stdint.h>

struct motion_sample {
    int16_t x;
    int16_t y;
    int16_t z;
};

struct motion_gate_config {
    int32_t min_score_mg;
    int32_t cooldown_ms;
};

struct motion_gate {
    bool moving;
    bool has_last_emit;
    int64_t last_emit_ms;
};

enum motion_gate_decision {
    MOTION_GATE_NONE = 0,
    MOTION_GATE_EMIT,
    MOTION_GATE_INACTIVITY,
};

int32_t motion_score_mg(const struct motion_sample *samples, size_t count);

enum motion_gate_decision motion_gate_update(struct motion_gate *gate,
                                             const struct motion_gate_config *cfg,
                                             bool hw_wake,
                                             bool hw_inactivity,
                                             int32_t score_mg,
                                             int64_t now_ms);
```
